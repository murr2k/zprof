## firmware/zprof/Kconfig
```kconfig
# zprof: runtime trace and metrics for Zephyr, streamed off the target.
# SPDX-License-Identifier: Apache-2.0

config ZPROF
	bool "zprof runtime trace and metrics"
	depends on TRACING_CUSTOM
	select THREAD_NAME
	select THREAD_MONITOR
	select THREAD_STACK_INFO
	help
	  zprof records scheduler, interrupt and kernel-object events with
	  cycle timestamps into a RAM ring and sends them to the zprof host
	  bridge. It is Zephyr's tracing format for the build: select
	  TRACING_CUSTOM (the module supplies zephyr_custom_tracing.h).

if ZPROF

config ZPROF_HOOKS_IN_RAM
	bool "Run the trace hooks from RAM"
	default y if XIP && ARCH_HAS_RAMFUNC_SUPPORT
	help
	  Place the hooks that run on every context switch, interrupt and
	  idle entry in RAM (__ramfunc). On an XIP image an instruction-cache
	  miss in a hook would otherwise fetch from external flash.

config ZPROF_RING_SIZE
	int "Event ring, bytes (a power of two)"
	default 32768
	help
	  In internal RAM (or the core's DTCM, ZPROF_RING_DTCM): the hooks
	  write it from interrupts and the context switch, where a cache miss
	  to external RAM would add hundreds of cycles of jitter. At 30 to 40
	  thousand events a second 32 KB covers about 80 to 100 ms of a sender
	  that cannot run.

config ZPROF_RECORDER_POST_MS
	int "Flight recorder armed at boot: ms recorded after a trigger (0: off)"
	default 0
	help
	  Armed, with no client connected, the hooks keep recording into
	  the ring (its oldest records go) and ZPROF_TRIGGER freezes it this
	  long after; the next client collects it first. A host arms it at
	  run time too (zprof_bridge recorder arm). The history it keeps is
	  the ring's size at the event rate (64 KB: a fraction of a second).

config ZPROF_PMU
	bool "The CPU's PMU counts (Armv8.1-M)"
	depends on CPU_CORTEX_M55 || CPU_CORTEX_M85
	help
	  Off unless chosen: zprof takes the PMU over (its event types and
	  counters), which an application that uses the PMU itself would
	  find changed.
	  Four 32-bit counts from the M-profile PMU (each a chained pair of
	  its 16-bit event counters): instructions, instruction- and
	  data-cache refills and back-end stall cycles unless a host picks
	  other events (CT_PMU). A PMU record at every heartbeat, and with
	  per-thread counts on, after every thread switch (eight register
	  reads and a 24-byte record each).

config ZPROF_PMU_SWITCH
	bool "PMU counts at every thread switch from the start of a session"
	depends on ZPROF_PMU
	help
	  Per-thread counts without the host asking. A host turns them on
	  and off at run time either way.

config ZPROF_FAULT
	bool "Fault records (zprof_fault_capture)"
	depends on CPU_CORTEX_M
	help
	  Off unless chosen. zprof_fault_capture(), called from a fatal
	  error handler, keeps the fault (registers, the thread, a call
	  trace of return addresses), puts it in the trace, freezes an armed
	  flight recorder and hands the record to the clients. An
	  application with its own k_sys_fatal_error_handler calls it there
	  and keeps its own policy. Best with EXTRA_EXCEPTION_INFO and
	  ARCH_STACKWALK (callee-saved registers, the call trace).

config ZPROF_FAULT_HANDLER
	bool "zprof supplies k_sys_fatal_error_handler"
	depends on ZPROF_FAULT
	help
	  Off unless chosen: adding zprof never changes how a device fails.
	  On, zprof's handler captures the fault and halts as Zephyr's own
	  does (or runs on, ZPROF_FAULT_CONTINUE). It clashes at link time
	  with an application's own handler.

config ZPROF_FAULT_CONTINUE
	bool "After a fault in a thread that is not essential, run on"
	depends on ZPROF_FAULT_HANDLER
	help
	  Off unless chosen. zprof's handler returns and the kernel ends
	  only the faulting thread, so the device stays up to report it; a
	  fault in an interrupt, an essential thread (main, idle) or a panic
	  still halts. A thread ended this way may leave what it held (a
	  mutex, a buffer) held for good, and the rest of the system runs
	  without it. Neither halting nor running on is safe for every
	  system (a halted CPU can leave a power stage's switch on; running
	  on can leave a control loop dead): choose it for this product,
	  with the safety net in hardware (a watchdog, a timer's break
	  input).

config ZPROF_BUS
	bool "The protocol analyzer: Ethernet frames, I2C messages, disk transfers"
	help
	  Off unless chosen: nothing is rerouted through zprof unless the
	  build asks. Records of bus traffic, each kind only while a host
	  asks for it (CT_PROTO; every session starts with none): I2C
	  messages and disk transfers (their timing, not their data unless
	  ZPROF_BUS_I2C_DATA), and Ethernet frames (their first 56 bytes,
	  zprof's own stream left out) where the build also opts in. The
	  driver-specific options wrap the driver's function at link time.
	  zprof's port has no login: whoever reaches it can switch on what
	  is built in.

if ZPROF_BUS

config ZPROF_BUS_ETH_RX
	bool "Received Ethernet frames (net_recv_data): opt in"
	depends on NETWORKING
	help
	  Off unless chosen. The frames' headers name every host the target
	  talks to (MAC and IP addresses, ports), and zprof's port has no
	  login: with this built in, any machine that can reach the port can
	  turn it on and read the target's traffic headers. Build it in only
	  where that is acceptable (a development network, not inside a
	  secure perimeter), and keep its captures private.

config ZPROF_BUS_ETH_STM32_TX
	bool "Transmitted Ethernet frames (wraps the STM32 driver's eth_stm32_tx): opt in"
	depends on ETH_STM32_HAL && !ETH_STM32_HAL_TX_ASYNC
	help
	  Off unless chosen, for the reasons given for ZPROF_BUS_ETH_RX.

config ZPROF_BUS_I2C_STM32
	bool "I2C messages (wraps the STM32 driver's i2c_stm32_transaction)"
	default y
	depends on I2C_STM32 && !I2C_RTIO
	help
	  Address, device, length, duration and return code of every
	  message; its data only with ZPROF_BUS_I2C_DATA.

config ZPROF_BUS_I2C_DATA
	bool "Keep the first 8 data bytes of each I2C message: opt in"
	depends on ZPROF_BUS_I2C_STM32
	help
	  Off unless chosen. The bytes on a bus can be sensitive: a touch
	  controller on a PIN pad tells where fingers press, a secure element
	  or a memory may carry keys. Useful when debugging a driver's
	  register traffic on a development board.

config ZPROF_BUS_DISK
	bool "Disk transfers (wraps disk_access_read and disk_access_write)"
	default y
	depends on DISK_ACCESS

endif # ZPROF_BUS

DT_CHOSEN_Z_DTCM := zephyr,dtcm

config ZPROF_RING_DTCM
	bool "Event ring in the core's DTCM"
	default y
	depends on $(dt_chosen_enabled,$(DT_CHOSEN_Z_DTCM))
	help
	  Place the ring and its state in the data TCM the board chooses as
	  zephyr,dtcm (Zephyr's .dtcm_bss, zeroed at boot): single-cycle and
	  uncached, written on the hottest path in the system, and out of the
	  general RAM budget. Only the CPU touches the ring (the network stack
	  copies out of it), so a TCM that other bus masters cannot reach is
	  fine.

choice ZPROF_TS
	prompt "Timestamp source"
	default ZPROF_TS_DWT if CPU_CORTEX_M_HAS_DWT
	default ZPROF_TS_KCYCLE

config ZPROF_TS_DWT
	bool "DWT cycle counter (one load)"
	depends on CPU_CORTEX_M_HAS_DWT

config ZPROF_TS_KCYCLE
	bool "Kernel cycle counter (k_cycle_get_32)"

endchoice

config ZPROF_SYNC_MS
	int "Interval of SYNC records, ms"
	default 250

config ZPROF_HEARTBEAT_MS
	int "Heartbeat: every metric sent this often, ms"
	default 100

config ZPROF_STACK_DIVIDER
	int "Stack watermarks every Nth heartbeat (0: never)"
	default 10
	help
	  Each thread's stack bytes never used (needs INIT_STACKS), one
	  STACK record per thread.

config ZPROF_CAPTURE_KB
	int "Capture-then-upload buffer, KB (0: no capture mode)"
	default 0
	help
	  Asked for from zprof_port_alloc() at the first capture and kept.
	  While a capture records, the sender moves the ring into it and
	  sends only a status every 500 ms; at the end it uploads it. At
	  20,000 events a second (about 250 KB/s) 4096 KB hold 16 s.

config ZPROF_TRANSPORT_TCP
	bool "Send over TCP"
	default y
	depends on NET_SOCKETS

if ZPROF_TRANSPORT_TCP

config ZPROF_TCP_PORT
	int "TCP port"
	default 5560

config ZPROF_SENDER_PRIO
	int "Sender thread priority"
	default 14
	help
	  Below the application: the sender only moves the ring to the
	  network. When it cannot keep up the ring drops, and the host shows
	  where.

config ZPROF_SENDER_STACK
	int "Sender thread stack, bytes"
	default 3072

config ZPROF_SENDER_PERIOD_MS
	int "Sender period, ms"
	default 10
	help
	  How often the sender looks at the ring. It sends when the ring
	  holds ZPROF_DRAIN_BYTES or its oldest data is ZPROF_DRAIN_MS old.

config ZPROF_SENDER_BUSY_MS
	int "Sender period while the ring fills fast, ms"
	default 2
	help
	  Used after a look at the ring found an eighth of it or more.

config ZPROF_DRAIN_BYTES
	int "Send when the ring holds this much, bytes"
	default 4096
	help
	  A send costs the sender about the same whatever its size (measured
	  on the N6: sending every 10 ms at 115 KB/s took 1.8 % of the CPU).

config ZPROF_DRAIN_MS
	int "Send at least this often, ms"
	default 50

config ZPROF_SEND_CHUNK
	int "Largest trace frame, bytes"
	default 8192

endif # ZPROF_TRANSPORT_TCP

endif # ZPROF
```
